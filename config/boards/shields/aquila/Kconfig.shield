## config/boards/shields/aquila/Kconfig.shield
```kconfig
# Copyright (c) 2020 The ZMK Contributors
# SPDX-License-Identifier: MIT

config SHIELD_AQUILA_LEFT
	def_bool $(shields_list_contains,aquila_left)

config SHIELD_AQUILA_RIGHT
	def_bool $(shields_list_contains,aquila_right)
```
